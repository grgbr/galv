## Config.in
```kconfig
################################################################################
# SPDX-License-Identifier: LGPL-3.0-only
#
# This file is part of Galv.
# Copyright (C) 2017-2025 Grégor Boirie <gregor.boirie@free.fr>
################################################################################

config GALV_ASSERT_API
	bool "API assertion"
	default n
	help
	  Build Galv library with high-level API assertions enabled to ensure
	  that API functions exposed by Utils will perform full verification of
	  arguments consistency.

config GALV_ASSERT_INTERN
	bool "Internal assertion"
	select GALV_ASSERT_API
	default n
	help
	  Build Galv library with internal assertions enabled.

config GALV_LOG
	bool "Logging"
	default y
	help
	  Build Galv library with internal logging support enabled.

config GALV_DEBUG
	bool "Debug"
	default n
	select GALV_LOG
	help
	  Build Galv library with internal debug logging support enabled.

config GALV_UTEST
	bool "Unit tests"
	default n
	help
	  Build Galv library unit test suite.

config GALV_GATE
	bool "Connection gate"
	default n
	help
	  Build Galv library with socket connection filtering support.

config GALV_UNIX
	bool "Unix socket connection"
	default y
	help
	  Build Galv library with Unix socket based connection support.

config GALV_UNIX_GATE_HASH_RATIO
	int "Unix socket gate hash fill ratio"
	depends on GALV_UNIX && GALV_GATE
	default 70
	help
	  Unix socket based connection filtering hash table targeted fill ratio.

config GALV_UNIX_GATE_HASH_BITS
	int "Unix socket gate hash log size"
	depends on GALV_UNIX && GALV_GATE
	default 8
	help
	  Logarithm base 2 of maximum number of buckets of Unix socket based
	  connection filtering hash table.

config GALV_BUFF
	bool "Core network buffer"
	default n
	help
	  Build Galv library with network buffer support.

config GALV_FRAG
	bool "Core network fragment"
	select GALV_BUFF
	default n
	help
	  Build Galv library with network fragment support.

config GALV_SESS
	bool "Session protocol"
	select GALV_FRAG
	default n
	help
	  Build Galv library with session protocol support.

config GALV_SESS_PLOAD_SIZE_MAX
	int "Maximum session payload size"
	depends on GALV_SESS
	range 8 1048576
	default 131072
	help
	  Size in bytes of the largest session message user payload supported.

config GALV_SESS_BUFF_CAPA_MAX
	int "Maximum session buffer size"
	depends on GALV_SESS
	range 8 131072
	default 4096
	help
	  Size in bytes of the largest session buffer supported.

config GALV_RPC
	bool "RPC helper"
	select GALV_SESS
	default n
	help
	  Build Galv library with rpc support.

config GALV_SMPL
	bool "Sample code"
	default n
	help
	  Build Galv library with usage sample code.

config GALV_SMPL_DISC_SRV
	bool "Discard server sample code"
	depends on GALV_SMPL
	select GALV_UNIX
	default n
	help
	  Build Galv library with discard service usage sample code.

config GALV_SMPL_ECHO_CLNT
	bool "Echo client sample code"
	depends on GALV_SMPL
	select GALV_UNIX
	default n
	help
	  Build Galv library with echo client usage sample code.

config GALV_SMPL_ECHO_SRV
	bool "Echo server sample code"
	depends on GALV_SMPL
	select GALV_UNIX
	default n
	help
	  Build Galv library with echo service usage sample code.

config GALV_SMPL_SESS_SRV
	bool "Session sample code"
	depends on GALV_SMPL
	select GALV_UNIX
	select GALV_SESS
	default n
	help
	  Build Galv library with session service usage sample code.
```
